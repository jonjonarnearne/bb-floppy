/*
* Copyright (C) 2018 Jon Arne Joergensen <jonjon.arnearne@gmail.com>
* V - a0 23.3.2018
* part-number is shown in $SLOTS
*
* Pinmode:
* BIT 0-2 : [0 - 7] Mode
* BIT 3   : [0 | 1] ENABLE | DISABLE \ PULLUP|PULLDOWN

* BIT 4   : [0 | 1] PULLDOWN | PULLUP 
* BIT 5   : [0 | 1] OUTPUT | INPUT
* BIT 6   : [0 | 1] Slew Fast | Slew Slow
* BIT 7   : N\A


    THIS FILE MUST BE COMPILED ON HOST ???? !!!!
*/

/dts-v1/;
/plugin/;

/ {
  compatible = "ti,beaglebone-black";
  part-number = "BB-BONE-FLOPPY";
  version = "00A0";

	/* State the resources this cape uses: 10 Pins
     * 6 Outputs:
            Head Select     - 
            Write Enable    -
            Write Data      
            Step           
            Direction     
            Motor Enable
            |Drive Select 
     * 4 Inputs:
            Read Data    
            Track 0     
            Ready      
            Index     
	    Chng         
	    WriteProtect

		"pruss";
    */
	exclusive-use =
		"P8.15",        /* Input - (CHNG | WRITE_PROT?)*/
		"P8.16",        /* Input - Index */
		"P9.24",        /* Input - ReadData */
		"P9.25",        /* Input - Track 0 */
		"P9.27",        /* Input - Ready */

                "P8.11",        /* Output - Unused */        
                "P8.12",        /* Output - Unused */        

		"P9.28",        /* Output - SIDE1 */
		"P9.29",        /* Output - HEAD STEP */
		"P9.30",        /* Output - HEAD DIR */
		"P9.31",        /* Output - WGATE */
		"P9.41",        /* Output - WDATA */
		"P9.42",        /* Output - MTRB + BSEL */
        "pru0";

	fragment@0 {
		target = <&am33xx_pinmux>;
		__overlay__ {

			pru_pru_pins: pinmux_pru_pru_pins {
				pinctrl-single,pins = <
                    0x03c 0x26 /* P8_15 = pr1_pru0_pru_r31_15 ( MODE6 | INPUT )             */
                    0x038 0x26 /* P8_16 = pr1_pru0_pru_r31_14 ( MODE6 | INPUT )             */
                    0x184 0x2e /* P9_24 = pr1_pru0_pru_r31_16 ( MODE6 | INPUT | DISABLE )   */
                    0x1ac 0x2e /* P9_25 = pr1_pru0_pru_r31_7  ( MODE6 | INPUT | DISABLE )   */
                    0x1a4 0x2e /* P9_27 = pr1_pru0_pru_r31_5  ( MODE6 | INPUT | DISABLE )   */

                    0x034 0x16 /* P8_11 = pr1_pru0_pru_r30_15 ( MODE6 | OUTPUT | PULL UP )  */
                    0x030 0x16 /* P8_12 = pr1_pru0_pru_r30_14 ( MODE6 | OUTPUT | PULL UP )  */

                    0x19c 0x15 /* P9_28 = pr1_pru0_pru_r30_3  ( MODE5 | OUTPUT | PULL UP )  */
                    0x194 0x15 /* P9_29 = pr1_pru0_pru_r30_1  ( MODE5 | OUTPUT | PULL UP )  */
                    0x198 0x15 /* P9_30 = pr1_pru0_pru_r30_2  ( MODE5 | OUTPUT | PULL UP )  */
                    0x190 0x15 /* P9_31 = pr1_pru0_pru_r30_0  ( MODE5 | OUTPUT | PULL UP )  */
                    0x1a8 0x15 /* P9_41 = pr1_pru0_pru_r30_6  ( MODE5 | OUTPUT | PULL UP )  */
                    0x1a0 0x15 /* P9_42 = pr1_pru0_pru_r30_4  ( MODE5 | OUTPUT | PULL UP )  */
				>;
			};
		};
	};

	fragment@2{
		target = <&pruss>;
		__overlay__ {
			status = "okay";

			pinctrl-names = "default";
			pinctrl-0 = <&pru_pru_pins>;
		};
	};
};

